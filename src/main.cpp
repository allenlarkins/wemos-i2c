#include <Arduino.h>
#include <Wire.h>
#include <Adafruit_GFX.h>
#include <Adafruit_SH110X.h>

#include "Menu.h"


// Pin definitions for the rotary encoder and buttons
constexpr uint8_t ENC_ROT_PIN       = 14;   // Wemos D5, TRA
constexpr uint8_t ENC_ROT_DIR_PIN   = 12;   // Wemos D6, TRB
constexpr uint8_t SELECT_PIN        = 13;   // Wemos D7, PSH
constexpr uint8_t BACK_PIN          = 16;   // Wemos D0, BAR

enum class EncoderMovement {
  None = 0,
  Clockwise = 1,
  AntiClockwise = -1
};

// OLED display configuration
constexpr uint8_t OLED_ADDRESS      = 0x3C;
constexpr uint8_t OLED_SDA          = 4;    // Wemos D2
constexpr uint8_t OLED_SCL          = 5;    // Wemos D1
constexpr int16_t OLED_WIDTH        = 128;
constexpr int16_t OLED_HEIGHT       = 64;


//ref:https://javl.github.io/image2cpp/
const uint8_t oled_image[] = {
0x21,0x21,0x21,0x01,0x09,0x09,0x09,0x08,0x3F,0xFF,0xFF,0xFF,0xFF,0xFF,0xC0,0x00,
0x00,0x22,0x00,0x04,0x40,0x00,0x88,0x0F,0xFF,0xFF,0xFF,0xFF,0xFF,0xFF,0xFF,0x44,
0x00,0x22,0x00,0x04,0x40,0x00,0x88,0x3F,0xFF,0xFF,0xFF,0xFF,0xFF,0xFF,0xFF,0xC0,
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0x00,0x28,0x00,0x00,0x00,0x00,0x00,0x00,0x0F,0xFF,0xFF,0xFF,0xFF,0xFF,0x00,0x00,
};

Adafruit_SH1106G display(OLED_WIDTH, OLED_HEIGHT, &Wire, -1);

// Menu tree, built as fixed static instances (no dynamic allocation).
extern Menu mainMenu;

MenuItem aboutMenuItems[] = {
  {"Version", nullptr},
  {"Build", nullptr},
};
Menu aboutMenu("About", aboutMenuItems, 2, &mainMenu);

MenuItem mainMenuItems[] = {
  {"Status", nullptr},
  {"Settings", nullptr},
  {"About", &aboutMenu},
};
Menu mainMenu("D1 mini menu", mainMenuItems, 3, nullptr);

Menu *activeMenu = &mainMenu;

int lastEncoderA = HIGH;
int lastSelect = HIGH;
int lastBack = HIGH;
unsigned long lastInputMs = 0;

// Forward declarations
bool inputReady();
EncoderMovement processRotaryEncoder();


void drawImage() {
  // 0x3C is default i2c adress in some cases MAY be different
  display.clearDisplay();
  display.setTextSize(2);
  display.setTextColor(SH110X_WHITE);
  display.drawBitmap(0, 0, oled_image, OLED_WIDTH, OLED_HEIGHT, SH110X_WHITE);
  display.display();
}


bool inputReady() {
  const unsigned long now = millis();
  if (now - lastInputMs < 35) return false;
  lastInputMs = now;
  return true;
}

void setup() {
  pinMode(ENC_ROT_PIN, INPUT_PULLUP);
  pinMode(ENC_ROT_DIR_PIN, INPUT_PULLUP);
  pinMode(SELECT_PIN, INPUT_PULLUP);
  pinMode(BACK_PIN, INPUT_PULLUP);
  lastEncoderA = digitalRead(ENC_ROT_PIN);

  Serial.begin(115200);  
  delay(50);              
  Serial.println(F("debug: boot menu"));

  Wire.begin(OLED_SDA, OLED_SCL);
  Wire.beginTransmission(OLED_ADDRESS);  
  const uint8_t oledAck = Wire.endTransmission();  
  Serial.print(F("debug: OLED 0x3C ACK="));  
  Serial.println(oledAck);  // 0 means the display answered.
  display.begin(OLED_ADDRESS, true);
  activeMenu->draw(display);
}

EncoderMovement processRotaryEncoder() {
  EncoderMovement l_encodeResult = EncoderMovement::None;
  const int rotated = digitalRead(ENC_ROT_PIN);
  if (rotated != lastEncoderA && rotated == LOW && inputReady()) {
    if (digitalRead(ENC_ROT_DIR_PIN) == HIGH) {
      l_encodeResult = EncoderMovement::Clockwise;
      Serial.println(F("debug: encoder turn - clockwise"));
    } else {
      l_encodeResult = EncoderMovement::AntiClockwise;
      Serial.println(F("debug: encoder turn - anti-clockwise"));
    }
    activeMenu->draw(display);
  }
  lastEncoderA = rotated;
  return l_encodeResult;
}

void loop() {

  //
  // Check the rotary encoder and buttons, and update the menu selection accordingly.
  //
  EncoderMovement l_rotaryMotion = processRotaryEncoder();
  if (l_rotaryMotion == EncoderMovement::Clockwise) {
    activeMenu->selectNext();
    activeMenu->draw(display);
  } else if (l_rotaryMotion == EncoderMovement::AntiClockwise) {
    activeMenu->selectPrevious();
    activeMenu->draw(display);
  }

  const int l_selectNow = digitalRead(SELECT_PIN);
  if (lastSelect == HIGH && l_selectNow == LOW && inputReady()) {
    Serial.println(F("schematik-debug: select press"));
    Menu *submenu = activeMenu->selectedSubmenu();
    if (submenu != nullptr) {
      activeMenu = submenu;
      activeMenu->draw(display);
    } else {
      activeMenu->drawSelection(display);
    }
  }
  lastSelect = l_selectNow;

  const int l_backNow = digitalRead(BACK_PIN);
  if (lastBack == HIGH && l_backNow == LOW && inputReady()) {
    Serial.println(F("schematik-debug: back press"));
    if (activeMenu->parent() != nullptr) {
      activeMenu = activeMenu->parent();
    }
    activeMenu->draw(display);
  }
  lastBack = l_backNow;
}